// https://learn.adafruit.com/adafruit-16-channel-pwm-slash-servo-shield?view=all#library-reference
// https://www.youtube.com/watch?v=pne01vHabMw
// https://github.com/adafruit/Adafruit-PWM-Servo-Driver-Library
// https://www.youtube.com/watch?v=y8X9X10Tn1k
// https://www.youtube.com/watch?v=EUd4Fqot1Mc&t=114s

#include <Wire.h>
#include <Adafruit_PWMServoDriver.h>
#define NUM_SERVOS 6
//////////////////(MQTT inicio)//////////////////////////////////////////////////////////////////////////////////////////////////////////////////////////////////////////////////
#include <PubSubClient.h>
#include <ESP8266WiFi.h>

// Globales
// Crear una ionstancia de WIfi client
WiFiClient espClient;
// Crear una instancia del MQTT client, basado en el cliente Wifi
PubSubClient client(espClient);

// otras variables
long lastMsg = 0;
char msg[50];
int value = 0;

// Credenciales para conecatarse al wifi
const char* ssid = "Moche";
const char* password = "97788122";

// Direccion IP de la maquina en la red que corre el broker MQTT
// se ingresa por web a ui por: pollo.local:1880/ui
const char* mqtt_server = "pollo.local";
//////////////////(MQTT fin)///////////////////////////////////////////////////////////////////////////////////////////////////////////////////////////////////////////////////////////
  
Adafruit_PWMServoDriver servos = Adafruit_PWMServoDriver();

#define SERVOMIN  400 // This is the 'minimum' pulse length count (out of 4096)
#define SERVOMAX  2500 // This is the 'maximum' pulse length count (out of 4096)

#define FREQUENCY 50

// our servo # counter
int servo_num[NUM_SERVOS]= {0, 1, 4, 5, 8, 9};

///////////////////////////////////////////////////////////////////////////////////////////////////////////////////////////////////////////////////////////////////////////////////////
//////////////////////(Setup inicio)////////////////////////////////////////////////////////////////////////////////////////////////////////////////////////////////////////////////////////
///////////////////////////////////////////////////////////////////////////////////////////////////////////////////////////////////////////////////////////////////////////////////////
void setup() {
  Serial.begin(115200);
  Serial.println("8 channel Servo test!");

  // Inicializando la libreria para comunicarse con el PCA9685
  servos.begin();
  
  //pwm.setOscillatorFrequency(27000000);
  servos.setPWMFreq(50);  // Analog servos run at ~50 Hz updates. Determines how many full 'pulses' per second are generated by the IC

  delay(FREQUENCY);

  //////////////////(MQTT inicio)///////////////////////////////////////////////////////////////////////////////////////////////////////////////////////////////////////////////////////////
  // conectarse a wifi
  setup_wifi();

  // Configurar el MQTT client
  client.setServer(mqtt_server, 8883);
  client.setCallback(callback);

  //////////////////(MQTT fin)///////////////////////////////////////////////////////////////////////////////////////////////////////////////////////////////////////////////////////////
}

///////////////////////////////////////////////////////////////////////////////////////////////////////////////////////////////////////////////////////////////////////////////////////
//////////////////////(Setup fin)////////////////////////////////////////////////////////////////////////////////////////////////////////////////////////////////////////////////////////
///////////////////////////////////////////////////////////////////////////////////////////////////////////////////////////////////////////////////////////////////////////////////////


///////////////////////////////////////////////////////////////////////////////////////////////////////////////////////////////////////////////////////////////////////////////////////
//////////////////////(Loop inicio)////////////////////////////////////////////////////////////////////////////////////////////////////////////////////////////////////////////////////////
///////////////////////////////////////////////////////////////////////////////////////////////////////////////////////////////////////////////////////////////////////////////////////
void loop() {

  //////////////////(MQTT inicio)///////////////////////////////////////////////////////////////////////////////////////////////////////////////////////////////////////////////////////////
  // Realiza conexion MQTT (publisher: envia datos) desde ESP8266 a broker
  if(!client.connected()){
    reconnect();
  }
  client.loop();

  //////////////////(MQTT fin)///////////////////////////////////////////////////////////////////////////////////////////////////////////////////////////////////////////////////////////
  
  
}
///////////////////////////////////////////////////////////////////////////////////////////////////////////////////////////////////////////////////////////////////////////////////////
//////////////////////(Loop fin)////////////////////////////////////////////////////////////////////////////////////////////////////////////////////////////////////////////////////////
///////////////////////////////////////////////////////////////////////////////////////////////////////////////////////////////////////////////////////////////////////////////////////

//////////////////(MQTT inicio)///////////////////////////////////////////////////////////////////////////////////////////////////////////////////////////////////////////////////////////
// Realiza conexion al wifi
void setup_wifi(){
  delay(10);
  Serial.println();
  Serial.print("Conectando a ");
  Serial.println(ssid);
  WiFi.begin(ssid, password);
  while(WiFi.status() != WL_CONNECTED){
      delay(500);
      Serial.print(".");
  }
  Serial.println("");
  Serial.println("Wifi conectado");
  Serial.println("IP adress: ");
  Serial.println(WiFi.localIP());
}

// Realizando conexion MQTT
void callback(char* topic, byte* message, unsigned int length){
  Serial.print("Mensaje recibido en topic: ");
  Serial.print(topic);
  Serial.print(", Message: ");
  String messageMotor;
  for(int i = 0; i < length; i++){
    Serial.print((char)message[i]);
    messageMotor += (char)message[i];
  }
  Serial.println();

  // Primer output (usando topic: esp8266/moverMotor1)
  if(String(topic) == "esp8266/moverMotor1"){ // Si recibe mensaje sobre topic "esp8266/moverMotor1", se debe de mover el motor
    Serial.print("Mover el motor 1");
    if(messageMotor == "on"){
      Serial.println("on");
      moverMotor(0);
    }
  }

  // Segundo output (usando topic: esp8266/moverMotor2)
  if(String(topic) == "esp8266/moverMotor2"){
    Serial.print("Mover el motor 2");
    if(messageMotor == "on"){
      Serial.println("on");
      moverMotor(1);
    }
  }

  // Segundo output (usando topic: esp8266/moverMotor3)
  if(String(topic) == "esp8266/moverMotor3"){
    Serial.print("Mover el motor 3");
    if(messageMotor == "on"){
      Serial.println("on");
      moverMotor(2);
    }
  }

  // Segundo output (usando topic: esp8266/moverMotor4)
  if(String(topic) == "esp8266/moverMotor4"){
    Serial.print("Mover el motor 4");
    if(messageMotor == "on"){
      Serial.println("on");
      moverMotor(3);
    }else if(messageMotor == "off"){
      Serial.println("off");
      // detenerMotor(1);
    }
  }

  // Segundo output (usando topic: esp8266/moverMotor5)
  if(String(topic) == "esp8266/moverMotor5"){
    Serial.print("Mover el motor 5");
    if(messageMotor == "on"){
      Serial.println("on");
      moverMotor(4);
    }else if(messageMotor == "off"){
      Serial.println("off");
      // detenerMotor(1);
    }
  }

  // Segundo output (usando topic: esp8266/moverMotor6)
  if(String(topic) == "esp8266/moverMotor6"){
    Serial.print("Mover el motor 6");
    if(messageMotor == "on"){
      Serial.println("on");
      moverMotor(5);
    }else if(messageMotor == "off"){
      Serial.println("off");
      // detenerMotor(1);
    }
  }

  

  
}

// Realiza la reconexion en caso de fallo
void reconnect(){
  // Bucle hasta que reconecte
  while(!client.connected()){
      Serial.print("Intentado conexion MQTT");
      if(client.connect("ESP8266Client")){
        Serial.println("conectado");
        client.subscribe("esp8266/moverMotor1"); // Topic : 'esp8266/output1'
        client.subscribe("esp8266/moverMotor2"); // Topic : 'esp8266/output2'
        client.subscribe("esp8266/moverMotor3"); // Topic : 'esp8266/output2'
        client.subscribe("esp8266/moverMotor4"); // Topic : 'esp8266/output2'
        client.subscribe("esp8266/moverMotor5"); // Topic : 'esp8266/output2'
        client.subscribe("esp8266/moverMotor6"); // Topic : 'esp8266/output2'
      }else{
        Serial.print("Fallo, rc =");
        Serial.print(client.state());
        Serial.println(" Intentelo de nuevo en 5s");
        delay(5000);
      }
  }
}
//////////////////(MQTT fin)///////////////////////////////////////////////////////////////////////////////////////////////////////////////////////////////////////////////////////////

void moverMotor(int i){
  servos.setPWM(servo_num[i], 0, convert2angle(90)); // sentido horario
  delay(2000);
  servos.setPWM(servo_num[i], 0, 0); // detener
  delay(2000);
}

// Convertir angulo a pulso
int convert2angle(int myAng){
  int pulse, analog_value;
  pulse = map(myAng, 0, 360, SERVOMIN, SERVOMAX); // 0 grados se vuelve 150 y 180 se vuelve 600 de pulso
  analog_value = int(float(pulse) / 1000000 * FREQUENCY * 4096);
  Serial.println("Angulo/Pulso: ");
  Serial.println(myAng);
  Serial.println(" / ");
  Serial.println(pulse);
  Serial.println(" / ");
  Serial.println(analog_value);
  return analog_value;
}
